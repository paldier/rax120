## git_home/u-boot.git/arch/arm/cpu/armv7/qca_hw29765589p0p256p1024p4x4p8x8/Kconfig
```kconfig
if TARGET_HW29765589P0P256P1024P4X4P8X8

config QCA_COMMON
	bool "QCA Common IPs"

endif
```

## git_home/u-boot.git/arch/arm/cpu/armv7/qca_hw29765589p0p512p1024p4x4p8x8/Kconfig
```kconfig
if TARGET_HW29765589P0P512P1024P4X4P8X8

config QCA_COMMON
	bool "QCA Common IPs"

endif
```

## git_home/u-boot.git/board/qca/hw29765589p0p512p1024p4x4p8x8/Kconfig
```kconfig
if TARGET_HW29765589P0P512P1024P4X4P8X8

config SYS_BOARD
	default "hw29765589p0p512p1024p4x4p8x8"

config SYS_VENDOR
	default "qca"

config SYS_SOC
	default "qca_hw29765589p0p512p1024p4x4p8x8"

config SYS_CONFIG_NAME
	default "hw29765589p0p512p1024p4x4p8x8"

endif
```

## package/dni/net-util/Config.in
```kconfig
config net-util_WLAN_COMMON
	bool "net-util modules to support wlan common"
	default y
	help
		This defined macro "WLAN_COMMON_SUUPPORT" to let module "net-util"
		to support wlan common

config net-util_RFC3442_249
	bool "net-util modules to support rfc3442 249"
	default y
	help
		This defined macro "RFC3442_249_SUPPORT" to let module "net-util"
		to support rfc3442 249

config net-util_DNI_WAN_DNS3
	bool "net-util modules to support dni wan dns3"
	default y
	help
		This defined macro "DNI_WAN_DNS3_SUPPORT" to let module "net-util"
		to support dni wan dns3

config net-util_DETWANV6
	bool "net-util modules to support detwanv6"
	default y
	help
		This defined macro "DETWANV6" to let module "net-util"
		to support detwanv6
```

## package/dni/wlan-common/Config.in
```kconfig
config WLAN_COMMON_GIT_TREEISH
	string
	prompt "treeish of wlan-common git repository"
	default "7a7bda959113d8da7dca8aaf4d300e9f7cacdf07"
	help
           Input the treeish of wlan-common git repository which you want to build

config WLAN_COMMON_GIT_REPOSITORY
	string
	prompt "name of wlan-common git repository"
	default "wlan-common.git"
	help
	   Input the name of wlan-common git repository which you want to build

config WLAN_COMMON_GIT_URL
	string
	prompt "url of wlan-common git repository"
	default "ssh://dniserver/scm/dnigit/apps/wlan-common/spencer/wlan-common.git"
	help
	   Input the url of wlan-common git repository which you want to build
```

## package/qca/qsdk-wifi-script/Config.in
```kconfig
# QSDK WIFI SCRIPT configuration

menu "Configuration"

config QSDK_WIFI_SCRIPT_GIT_REPOSITORY
	string "Repository name of QSDK Wi-Fi script"
	default ""
	help
	  Specify the git repository name of QSDK Wi-Fi script, should be the foler name
	  in git_home path.

config QSDK_WIFI_SCRIPT_GIT_URL
	string "URL of QSDK Wi-Fi script in remote server"
	default ""
	help
	  Should be the URL to indentify repository path in dniserver.

config QSDK_WIFI_SCRIPT_GIT_TREEISH
	string "Which tag used on the git repository"
	default ""

endmenu
```
